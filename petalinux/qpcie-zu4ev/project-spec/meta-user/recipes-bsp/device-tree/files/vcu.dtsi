&vcu_0 {
	status = "okay";
	reset-gpios = <&gpio 78 0>;
	clock-names = "pll_ref", "aclk", "vcu_core_enc", "vcu_mcu_enc", "vcu_core_dec", "vcu_mcu_dec";
	clocks = <&zynqmp_clk 72>, <&zynqmp_clk 71>, <&vcu_0 0>, <&vcu_0 1>, <&vcu_0 2>, <&vcu_0 3>;
};

&encoder {
	memory-region = <&cma_vcu>;
};
