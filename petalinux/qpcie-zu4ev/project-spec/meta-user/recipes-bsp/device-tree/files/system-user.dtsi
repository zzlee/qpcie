#include "common.dtsi"

////////////////////////////////////////////////////////////////////////////
// SC7F0 Standalone Capture Card: No Ethernet (GEM0 disabled)
// Remove ethernet aliases so U-Boot / Linux do not attempt network init.

/ {
	aliases {
		/delete-property/ ethernet0;
		/delete-property/ ethernet1;
	};
};

&gem0 {
	status = "disabled";
};

////////////////////////////////////////////////////////////////////////////
// system peripherals

////////////////////////////////////////////////////////////////////////////
// qcap modules

#include "vcu.dtsi"

#include "sc6f0-mcu.dtsi"

/* Pair this image only with the HDMI RX IRQ-enabled hardware (26101906+). */
#if defined(SC7F0_HDMI_RX_ENABLE) && SC7F0_HDMI_RX_ENABLE
#include "sc7f0-hdmi-rx.dtsi"
#if defined(SC7F0_PS_CAPTURE_ENABLE) && SC7F0_PS_CAPTURE_ENABLE
#include "sc7f0-ps-capture.dtsi"
#endif
#else
/* Never probe HDMI register apertures on the debug-only hardware. */
/ {
	qpcie_v4l2_bridge {
		compatible = "yuan,qpcie-v4l2-bridge";
		status = "disabled";
	};
};
#endif

/* Must stay last: pins the card-validated bootargs after any hardware import. */
#include "sc7f0-memory-layout.dtsi"
