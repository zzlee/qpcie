## petalinux/qpcie-zu4ev/project-spec/configs/configs/Kconfig.syshw
```kconfig
menuconfig SUBSYSTEM_HARDWARE_AUTO
	bool "Subsystem AUTO Hardware Settings"
	default y
	help
	  This menu is to configure system hardware.

if SUBSYSTEM_HARDWARE_AUTO


config SUBSYSTEM_PROCESSOR0_IP_NAME
string
default psu_cortexa53_0

choice
	prompt "System Processor"
	help
	 Select a processor as the system processor
config SUBSYSTEM_PROCESSOR_psu_cortexa53_0_SELECT
	bool "psu_cortexa53_0"

endchoice

config SUBSYSTEM_ENABLE_ARCH64
	bool
	default y
	select SUBSYSTEM_ARCH_AARCH64
	depends on SUBSYSTEM_PROCESSOR_psu_cortexa53_0_SELECT

if SUBSYSTEM_PROCESSOR_psu_cortexa53_0_SELECT
menu "Memory Settings"
choice
	prompt "Primary Memory"
	help
	  The configuration in this menu impacts the memory settings in the device tree
	  autoconfig files.
	  If you select 'manual', PetaLinux will auto generate memory node based on user inputs,
	  you will need to specify base address and memory size.
	  To skip generating lower or upper memory node specify 0x0 offset to the memory size.
	config SUBSYSTEM_MEMORY_PSU_DDR_0_BANKLESS_SELECT
	bool "psu_ddr_0"
config SUBSYSTEM_MEMORY_PSU_DDR_1_BANKLESS_SELECT
	bool "psu_ddr_1"

config SUBSYSTEM_MEMORY_MANUAL_SELECT
	bool "manual"

	endchoice


config SUBSYSTEM_MEMORY_PSU_DDR_0_BANKLESS_BASEADDR
	hex "System memory base address"
	default 0x0
	range 0x0 0x7e000000
	depends on SUBSYSTEM_MEMORY_PSU_DDR_0_BANKLESS_SELECT
	help
	  Start address of the system memory.
	  It has to be within the selected primary memory physical address range.


config SUBSYSTEM_MEMORY_PSU_DDR_1_BANKLESS_BASEADDR
	hex "System memory base address"
	default 0x800000000
	range 0x800000000 0x87e000000
	depends on SUBSYSTEM_MEMORY_PSU_DDR_1_BANKLESS_SELECT
	help
	  Start address of the system memory.
	  It has to be within the selected primary memory physical address range.


config SUBSYSTEM_MEMORY_MANUAL_LOWER_BASEADDR
	hex "Lower memory base address"
	default 0x0
	depends on SUBSYSTEM_MEMORY_MANUAL_SELECT
	help
	  base address of the lower memory
	  Make sure the DT memory entry should start with provided address.


config SUBSYSTEM_MEMORY_PSU_DDR_0_BANKLESS_SIZE
	hex "System memory size"
	default 0x80000000
	range 0x2000000 0x80000000
	depends on SUBSYSTEM_MEMORY_PSU_DDR_0_BANKLESS_SELECT
	help
	  Size of the system memory. Minimum is 32MB, maximum is the size of
	  the selected primary memory physical address range.


config SUBSYSTEM_MEMORY_PSU_DDR_1_BANKLESS_SIZE
	hex "System memory size"
	default 0x80000000
	range 0x2000000 0x80000000
	depends on SUBSYSTEM_MEMORY_PSU_DDR_1_BANKLESS_SELECT
	help
	  Size of the system memory. Minimum is 32MB, maximum is the size of
	  the selected primary memory physical address range.


config SUBSYSTEM_MEMORY_MANUAL_LOWER_MEMORYSIZE
	hex "Lower memory size"
	default 0x80000000
	depends on SUBSYSTEM_MEMORY_MANUAL_SELECT
	help
	  Size of the lower memory. Minimum is 32MB, maximum is the size of
	  the selected primary memory physical address range.
	  If you specify 0x0 offset then it will skip generating lower memory node.


config SUBSYSTEM_MEMORY_MANUAL_UPPER_BASEADDR
	hex "Upper memory base address"
	default 0x800000000
	depends on SUBSYSTEM_MEMORY_MANUAL_SELECT
	depends on SUBSYSTEM_ARCH_AARCH64
	help
	  base address of the upper memory
	  Make sure the DT memory entry should start with provided address.


config SUBSYSTEM_MEMORY_MANUAL_UPPER_MEMORYSIZE
	hex "Upper memory size"
	default 0x80000000
	depends on SUBSYSTEM_MEMORY_MANUAL_SELECT
	depends on SUBSYSTEM_ARCH_AARCH64
	help
	  Size of the upper memory. Minimum is 32MB, maximum is the size of
	  the selected primary memory physical address range.
	  If you specify 0x0 offset then it will skip generating upper memory node.


config SUBSYSTEM_MEMORY_PSU_DDR_0_BANKLESS_KERNEL_BASEADDR
	hex "kernel base address"
	default 0x0
	range 0x0 0x7e000000
	depends on SUBSYSTEM_MEMORY_PSU_DDR_0_BANKLESS_SELECT
	depends on SUBSYSTEM_ARCH_ARM || SUBSYSTEM_ARCH_AARCH64
	help
	  kernel base address.


config SUBSYSTEM_MEMORY_PSU_DDR_1_BANKLESS_KERNEL_BASEADDR
	hex "kernel base address"
	default 0x800000000
	range 0x800000000 0x87e000000
	depends on SUBSYSTEM_MEMORY_PSU_DDR_1_BANKLESS_SELECT
	depends on SUBSYSTEM_ARCH_ARM || SUBSYSTEM_ARCH_AARCH64
	help
	  kernel base address.



config SUBSYSTEM_MEMORY_PSU_DDR_0_BANKLESS_U__BOOT_TEXTBASE_OFFSET
	hex "u-boot text base address offset to memory base address"
	default 0x8000000 if SUBSYSTEM_ARCH_AARCH64
	default 0x4000000 if SUBSYSTEM_ARCH_ARM
	default 0x100000 if SUBSYSTEM_ARCH_MICROBLAZE
	range 0x100000 0x7e100000
	depends on SUBSYSTEM_MEMORY_PSU_DDR_0_BANKLESS_SELECT
	depends on !SUBSYSTEM_COMPONENT_U__BOOT_NAME_NONE


config SUBSYSTEM_MEMORY_PSU_DDR_1_BANKLESS_U__BOOT_TEXTBASE_OFFSET
	hex "u-boot text base address offset to memory base address"
	default 0x808000000 if SUBSYSTEM_ARCH_AARCH64
	default 0x804000000 if SUBSYSTEM_ARCH_ARM
	default 0x800100000 if SUBSYSTEM_ARCH_MICROBLAZE
	range 0x800100000 0x87e100000
	depends on SUBSYSTEM_MEMORY_PSU_DDR_1_BANKLESS_SELECT
	depends on !SUBSYSTEM_COMPONENT_U__BOOT_NAME_NONE



config SUBSYSTEM_MEMORY_IP_NAME
	string
	default PSU_DDR_0
	depends on SUBSYSTEM_MEMORY_PSU_DDR_0_BANKLESS_SELECT


config SUBSYSTEM_MEMORY_IP_NAME
	string
	default PSU_DDR_1
	depends on SUBSYSTEM_MEMORY_PSU_DDR_1_BANKLESS_SELECT


endmenu

menu "Serial Settings"

choice
	prompt "PMUFW Serial stdin/stdout"

help
	  Select a serial as the PMUFW's stdin,stdout.
	  If you select 'manual', you will need to add this variable 
	  YAML_SERIAL_CONSOLE_STDIN:forcevariable:pn-PMUFW = "<serial_ipname>" 
	  YAML_SERIAL_CONSOLE_STDOUT:forcevariable:pn-PMUFW = "<serial_ipname>" 
config SUBSYSTEM_PMUFW_SERIAL_PSU_UART_1_SELECT
	bool "psu_uart_1"
config SUBSYSTEM_PMUFW_SERIAL_PSU_UART_0_SELECT
	bool "psu_uart_0"
config SUBSYSTEM_PMUFW_SERIAL_MANUAL_SELECT
bool "manual"
	endchoice

choice
	prompt "FSBL Serial stdin/stdout"

help
	  Select a serial as the FSBL's stdin,stdout.
	  If you select 'manual', you will need to add this variable 
	  YAML_SERIAL_CONSOLE_STDIN:forcevariable:pn-FSBL = "<serial_ipname>" 
	  YAML_SERIAL_CONSOLE_STDOUT:forcevariable:pn-FSBL = "<serial_ipname>" 
config SUBSYSTEM_FSBL_SERIAL_PSU_UART_1_SELECT
	bool "psu_uart_1"
config SUBSYSTEM_FSBL_SERIAL_PSU_UART_0_SELECT
	bool "psu_uart_0"
config SUBSYSTEM_FSBL_SERIAL_MANUAL_SELECT
bool "manual"
	endchoice

choice
	prompt "TF-A Serial stdin/stdout"

help
	  Select a serial as the TF-A's stdin,stdout.
	  If you select 'manual', you will need to add this variable 
	  YAML_SERIAL_CONSOLE_STDIN:forcevariable:pn-TF-A = "<serial_ipname>" 
	  YAML_SERIAL_CONSOLE_STDOUT:forcevariable:pn-TF-A = "<serial_ipname>" 

help
	  Select a serial as the TF-A's stdin,stdout.
	  If you select 'manual', you will need to add this variable 
	  ATF_CONSOLE:forcevariable = "<serial_ipname>" in petalinuxbps.conf 
config SUBSYSTEM_TF-A_SERIAL_PSU_UART_1_SELECT
	bool "psu_uart_1"
config SUBSYSTEM_TF-A_SERIAL_PSU_UART_0_SELECT
	bool "psu_uart_0"
config SUBSYSTEM_TF-A_SERIAL_MANUAL_SELECT
bool "manual"
	endchoice

choice
	prompt "DTG Serial stdin/stdout"

help
	  Select a serial as the DTG's stdin,stdout.
	  If you select 'manual', you will need to add this variable 
	  YAML_SERIAL_CONSOLE_STDIN:forcevariable:pn-DTG = "<serial_ipname>" 
	  YAML_SERIAL_CONSOLE_STDOUT:forcevariable:pn-DTG = "<serial_ipname>" 
config SUBSYSTEM_SERIAL_PSU_UART_1_SELECT
	bool "psu_uart_1"
config SUBSYSTEM_SERIAL_PSU_UART_0_SELECT
	bool "psu_uart_0"
config SUBSYSTEM_SERIAL_AXI_UART16550_0_SELECT
	bool "axi_uart16550_0"
config SUBSYSTEM_SERIAL_MANUAL_SELECT
bool "manual"
	endchoice


choice
	prompt "System stdin/stdout baudrate for psu_uart_1"
	default SUBSYSTEM_SERIAL_PSU_UART_1_BAUDRATE_115200
config SUBSYSTEM_SERIAL_PSU_UART_1_BAUDRATE_600
	bool "600"	
config SUBSYSTEM_SERIAL_PSU_UART_1_BAUDRATE_9600
	bool "9600"	
config SUBSYSTEM_SERIAL_PSU_UART_1_BAUDRATE_28800
	bool "28800"	
config SUBSYSTEM_SERIAL_PSU_UART_1_BAUDRATE_115200
	bool "115200"	
config SUBSYSTEM_SERIAL_PSU_UART_1_BAUDRATE_230400
	bool "230400"	
config SUBSYSTEM_SERIAL_PSU_UART_1_BAUDRATE_460800
	bool "460800"	
config SUBSYSTEM_SERIAL_PSU_UART_1_BAUDRATE_921600
	bool "921600"	
endchoice
choice
	prompt "System stdin/stdout baudrate for psu_uart_0"
	default SUBSYSTEM_SERIAL_PSU_UART_0_BAUDRATE_115200
config SUBSYSTEM_SERIAL_PSU_UART_0_BAUDRATE_600
	bool "600"	
config SUBSYSTEM_SERIAL_PSU_UART_0_BAUDRATE_9600
	bool "9600"	
config SUBSYSTEM_SERIAL_PSU_UART_0_BAUDRATE_28800
	bool "28800"	
config SUBSYSTEM_SERIAL_PSU_UART_0_BAUDRATE_115200
	bool "115200"	
config SUBSYSTEM_SERIAL_PSU_UART_0_BAUDRATE_230400
	bool "230400"	
config SUBSYSTEM_SERIAL_PSU_UART_0_BAUDRATE_460800
	bool "460800"	
config SUBSYSTEM_SERIAL_PSU_UART_0_BAUDRATE_921600
	bool "921600"	
endchoice
choice
	prompt "System stdin/stdout baudrate for axi_uart16550_0"
	default SUBSYSTEM_SERIAL_AXI_UART16550_0_BAUDRATE_115200
config SUBSYSTEM_SERIAL_AXI_UART16550_0_BAUDRATE_600
	bool "600"	
config SUBSYSTEM_SERIAL_AXI_UART16550_0_BAUDRATE_9600
	bool "9600"	
config SUBSYSTEM_SERIAL_AXI_UART16550_0_BAUDRATE_28800
	bool "28800"	
config SUBSYSTEM_SERIAL_AXI_UART16550_0_BAUDRATE_115200
	bool "115200"	
config SUBSYSTEM_SERIAL_AXI_UART16550_0_BAUDRATE_230400
	bool "230400"	
config SUBSYSTEM_SERIAL_AXI_UART16550_0_BAUDRATE_460800
	bool "460800"	
config SUBSYSTEM_SERIAL_AXI_UART16550_0_BAUDRATE_921600
	bool "921600"	
endchoice


config SUBSYSTEM_SERIAL_PMUFW_IP_NAME
string
default psu_uart_1 if SUBSYSTEM_PMUFW_SERIAL_PSU_UART_1_SELECT
default psu_uart_0 if SUBSYSTEM_PMUFW_SERIAL_PSU_UART_0_SELECT
default axi_uart16550_0 if SUBSYSTEM_PMUFW_SERIAL_AXI_UART16550_0_SELECT

config SUBSYSTEM_SERIAL_FSBL_IP_NAME
string
default psu_uart_1 if SUBSYSTEM_FSBL_SERIAL_PSU_UART_1_SELECT
default psu_uart_0 if SUBSYSTEM_FSBL_SERIAL_PSU_UART_0_SELECT
default axi_uart16550_0 if SUBSYSTEM_FSBL_SERIAL_AXI_UART16550_0_SELECT

config SUBSYSTEM_SERIAL_TF-A_IP_NAME
string
default cadence1 if SUBSYSTEM_TF-A_SERIAL_PSU_UART_1_SELECT
default cadence if SUBSYSTEM_TF-A_SERIAL_PSU_UART_0_SELECT
default dcc if SUBSYSTEM_TF-A_SERIAL_AXI_UART16550_0_SELECT

config SUBSYSTEM_SERIAL_IP_NAME
string
default psu_uart_1 if SUBSYSTEM_SERIAL_PSU_UART_1_SELECT
default psu_uart_0 if SUBSYSTEM_SERIAL_PSU_UART_0_SELECT
default axi_uart16550_0 if SUBSYSTEM_SERIAL_AXI_UART16550_0_SELECT

endmenu

menu "Ethernet Settings"
choice
	prompt "Primary Ethernet"
	help
	  Select a Ethernet used as primary Ethernet.
	  The primary ethernet will be used for u-boot networking if u-boot is
	  selected and will be used as eth0 in Linux.
	  If your preferred primary ethernet is not on the list, please select
	  'manual'.
config SUBSYSTEM_ETHERNET_PSU_ETHERNET_0_SELECT
	bool "psu_ethernet_0"
config SUBSYSTEM_ETHERNET_MANUAL_SELECT
	bool "manual"

endchoice


config SUBSYSTEM_ETHERNET_PSU_ETHERNET_0_MAC_AUTO
	bool "Randomise MAC address"
	default y if SUBSYSTEM_ARCH_MICROBLAZE
	default n
	depends on SUBSYSTEM_ETHERNET_PSU_ETHERNET_0_SELECT
	help
	  randomise MAC address for the primary ethernet.

config SUBSYSTEM_ETHERNET_PSU_ETHERNET_0_MAC_PATTERN
	string "Template for randomised MAC address"
	default "00:0a:35:00:??:??"
	depends on SUBSYSTEM_ETHERNET_PSU_ETHERNET_0_SELECT && SUBSYSTEM_ETHERNET_PSU_ETHERNET_0_MAC_AUTO
	help
	  Pattern for generating random MAC addresses - question mark
	  characters will be replaced by random hex digits

config SUBSYSTEM_ETHERNET_PSU_ETHERNET_0_MAC
	string "Ethernet MAC address"
	default "ff:ff:ff:ff:ff:ff"
	depends on SUBSYSTEM_ETHERNET_PSU_ETHERNET_0_SELECT && !SUBSYSTEM_ETHERNET_PSU_ETHERNET_0_MAC_AUTO
	help
	  Default mac set to ff:ff:ff:ff:ff:ff invalid mac address to read from EEPROM
	  if you want change with desired value you can change, example: 00:0a:35:00:22:01


config SUBSYSTEM_ETHERNET_PSU_ETHERNET_0_USE_DHCP
	bool "Obtain IP address automatically"
	default y
	depends on SUBSYSTEM_ETHERNET_PSU_ETHERNET_0_SELECT
	help
	  Set this option if you would like your SUBSYSTEM to use DHCP for
	  obtaining an IP address.

config SUBSYSTEM_ETHERNET_PSU_ETHERNET_0_IP_ADDRESS
	string "Static IP address"
	default "192.168.0.10"
	depends on SUBSYSTEM_ETHERNET_PSU_ETHERNET_0_SELECT && !SUBSYSTEM_ETHERNET_PSU_ETHERNET_0_USE_DHCP
	help
	  The IP address of your main network interface when static network
	  address assignment is used.

config SUBSYSTEM_ETHERNET_PSU_ETHERNET_0_IP_NETMASK
	string "Static IP netmask"
	default "255.255.255.0"
	depends on SUBSYSTEM_ETHERNET_PSU_ETHERNET_0_SELECT && !SUBSYSTEM_ETHERNET_PSU_ETHERNET_0_USE_DHCP
	help
	  Default netmask when static network address assignment is used.
	  In case of systemd please specify netmask value like CIDR notation Eg: 24 instead of 255.255.255.0
	  In case of sysvinit please specify netmask value like dot-decimal notation Eg: 255.255.255.0 instead of 24 

config SUBSYSTEM_ETHERNET_PSU_ETHERNET_0_IP_GATEWAY
	string "Static IP gateway"
	default "192.168.0.1"
	depends on SUBSYSTEM_ETHERNET_PSU_ETHERNET_0_SELECT && !SUBSYSTEM_ETHERNET_PSU_ETHERNET_0_USE_DHCP
	help
	  Default gateway when static network address assignment is used.

endmenu

menu "Flash Settings"
choice
	prompt "Primary Flash"
	help
	  Select a Flash instance used as Primary Flash.
	  PetaLinux auto config will apply the flash partition table settings
	  to the primary flash.
	  If you preferred flash is not on the list or you don't want PetaLinux
	  to manage your flash partition, please select manual.
config SUBSYSTEM_FLASH_MANUAL_SELECT
	bool "manual"

endchoice



config SUBSYSTEM_FLASH__ADVANCED_AUTOCONFIG
	bool "Advanced Flash Auto Configuration"
	default n
	depends on !SUBSYSTEM_FLASH_MANUAL_SELECT
	help
	  Select this option to enabled 



endmenu

menu "SD/SDIO Settings"
choice
	prompt "Primary SD/SDIO"
	help
	  Select a SD instanced used as primary SD/SDIO.
	  It allows you to select which SD controller is in the systems primary SD card interface.
	config SUBSYSTEM_PRIMARY_SD_PSU_SD_1_SELECT
	bool "psu_sd_1"
config SUBSYSTEM_PRIMARY_SD_PSU_SD_0_SELECT
	bool "psu_sd_0"
config SUBSYSTEM_PRIMARY_SD_MANUAL_SELECT
	bool "manual"

	endchoice

endmenu

config SUBSYSTEM_SD_PSU_SD_1_SELECT
	bool
	default y
config SUBSYSTEM_SD_PSU_SD_0_SELECT
	bool
	default y


menu "RTC Settings"
choice
	prompt "Primary RTC"
	help
	  Select a RTC instance used as primary timer for Linux kernel.
	  If your preferred RTC is not on the list, please select 'manual'.
	  If 'manual' is selected, you will be responsible to enable property
	  kernel driver for your RTC.
	config SUBSYSTEM_RTC_PSU_RTC_SELECT
	bool "psu_rtc"
config SUBSYSTEM_RTC_MANUAL_SELECT
	bool "manual"

endchoice

endmenu



config SUBSYSTEM_I2C_PSU_I2C_1_SELECT
	bool
	default y


config SUBSYSTEM_USB_PSU_USB_1_SELECT
	bool
	default y
config SUBSYSTEM_USB_PSU_USB_0_SELECT
	bool
	default y




endif
endif
```

## petalinux/qpcie-zu4ev/project-spec/configs/rootfsconfigs/Kconfig.user
```kconfig
menu "user packages " 
config gpio-demo  
	 bool "gpio-demo"
	 help
	
config peekpoke  
	 bool "peekpoke"
	 help
	
config qpcie-debugd  
	 bool "qpcie-debugd"
	 help
	
config qpcie-v4l2-bridge  
	 bool "qpcie-v4l2-bridge"
	 help
	
config sc7f0-ps-capture  
	 bool "sc7f0-ps-capture"
	 help
	
config sc7f0-vcud  
	 bool "sc7f0-vcud"
	 help
	
endmenu
```
